/dts-v1/;
/plugin/;
 
/ {
	compatible = "brcm,bcm2835", "brcm,bcm2836", "brcm,bcm2708", "brcm,bcm2709";
	fragment@0 {
		target = <&spidev0>;
		__overlay__ {
			status = "disabled";
		};
	};
	fragment@1 {
		target = <&spi0>;
		__overlay__ {
			#address-cells = <1>;
			#size-cells = <0>;
			sd0: sd@0 {
				reg = <0>;
				status = "okay";
				compatible = "spi,mmc_spi";
				voltage-ranges = <3200 3500>;
				spi-max-frequency = <25000000>;
			};
		};
	};
};
